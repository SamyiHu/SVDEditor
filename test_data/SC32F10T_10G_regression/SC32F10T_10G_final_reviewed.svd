# SC32F10T_10G register map
File version: 1.0
CPU: CM0+ r0p1, little endian, MPU, no FPU, 4 interrupt priority bits
Registers are 32-bit, read-write, reset 0x0 unless marked. A register's access mark holds for its fields unless they carry their own. Offsets are from the block's base; lines under a group give offsets from that group; [hi:lo] are bit positions; {n}, {i} and the like mark numbered series; 'fields as' and 'values as' point back to an identical list; <NAME> marks a mode.

## Memory map
0x40000330 WDT size 0x14
0x400003C0 IAP size 0x10
0x40002000 CRC size 0x10
0x40003000 RCC size 0x30
0x40010800 DMA0 size 0x14
0x40010840 DMA1 size 0x14
0x40010880 DMA2 size 0x14
0x400108C0 DMA3 size 0x14
0x40011000 PA size 0x64
0x40011100 PB size 0x64
0x40011200 PC size 0x64
0x40011300 INTF size 0xE4 — 外部中断
0x40020020 UART0 size 0x14
0x40020040 SPI0 size 0x14
0x40020060 TWI0 size 0x14
0x40020080 UART1 size 0x14
0x40020100 TIM0 size 0x1C
0x40020140 TIM1 size 0x1C
0x40020180 TIM2 size 0x1C
0x400201C0 TIM3 size 0x1C
0x40020200 PWM0 size 0x1C
0x40020230 PWM0_DTx size 0x20 — PWM0_DTx（x = 0~7）
0x40021020 UART2 size 0x14
0x40021040 SPI1 size 0x14
0x40021060 TWI1 size 0x14
0x40021100 TIM4 size 0x1C
0x40021140 TIM5 size 0x1C
0x40021180 TIM6 size 0x1C
0x400211C0 TIM7 size 0x1C
0x40022020 UART3 size 0x14
0x40022100 BTM size 0x8
0x40022110 ADC size 0x10
0x40022110 CMP size 0x8
0x40022280 LCD size 0x10 — LCD/LED
0x40022300 LEDPWM size 0x1C
0x40022330 SEGR size 0x70

## Interrupts
0 INT0 (INTF) — 优先级=可设；NVIC=NVIC->ISER[0].0；屏蔽位=INTF_IE->ENFx，x=0 INTR_IE->ENRx；标志位=INTF_STS->FIFx INTR_STS->RIFx；唤醒 STOP=能
1 INT1_7 (INTF) — 优先级=可设；NVIC=NVIC->ISER[0].1；屏蔽位=INTF_IE->ENFx，x=1~7 INTR_IE->ENRx；标志位=INTF_STS->FIFx INTR_STS->RIFx；唤醒 STOP=能
2 INT8_11 (INTF) — 优先级=可设；NVIC=NVIC->ISER[0].2；屏蔽位=INTF_IE->ENFx，x=8~11 INTR_IE->ENRx；标志位=INTF_STS->FIFx INTR_STS->RIFx；唤醒 STOP=能
3 INT12_15 (INTF) — 优先级=可设；NVIC=NVIC->ISER[0].3；屏蔽位=INTF_IE->ENFx，x=12~15 INTR_IE->ENRx；标志位=INTF_STS->FIFx INTR_STS->RIFx；唤醒 STOP=能
4 RCC — 优先级=可设；NVIC=NVIC->ISER[0].4；屏蔽位=RCC_CFG->INTEN；标志位=RCC_STS->CLKFIF；唤醒 STOP=不能
6 BTM — 优先级=可设；NVIC=NVIC->ISER[0].6；屏蔽位=BTM_CON->INTEN；标志位=BTM_STS->BTMIF；唤醒 STOP=能
7 UART0_2 (UART0, UART2) — 共享中断源：UART0 / UART2；优先级=可设；NVIC=NVIC->ISER[0].7；屏蔽位=UART0_IDE->INTEN；子开关=UART0_IDE->TXIE UART0_IDE->RXIE；标志位=UART0_STS->TXIF UART0_STS->RXIF；唤醒 STOP=不能
8 UART1_3 (UART1, UART3) — 共享中断源：UART1 / UART3；优先级=可设；NVIC=NVIC->ISER[0].8；屏蔽位=UART1_IDE->INTEN；子开关=UART1_IDE->TXIE UART1_IDE->RXIE；标志位=UART1_STS->TXIF UART1_STS->RXIF；唤醒 STOP=不能
9 SPI0 — 优先级=可设；NVIC=NVIC->ISER[0].9；屏蔽位=SPI0_IDE->INTEN；子开关=SPI0_IDE->RXNEIE SPI0_IDE->TBIE SPI0_IDE->RXIE SPI0_IDE->RXHIE SPI0_IDE->TXHIE；标志位=SPI0_STS->SPIF SPI0_STS->RXNEIF SPI0_STS->TXEIF SPI0_STS->RXFIF SPI0_STS->RXHIF SPI0_STS->TXHIF；唤醒 STOP=不能
10 SPI1 — 优先级=可设；NVIC=NVIC->ISER[0].10；屏蔽位=SPI1_IDE->INTEN；标志位=SPI1_STS->TXHIF；唤醒 STOP=不能
11 DMA0 — 优先级=可设；NVIC=NVIC->ISER[0].11；屏蔽位=DMA0_CFG->INTEN；子开关=DMA0_CFG->TCIE DMA0_CFG->HTIE DMA0_CFG->TEIE；标志位=DMA0_STS->GIF DMA0_STS->TCIF DMA0_STS->HTIF DMA0_STS->TEIF；唤醒 STOP=不能
12 DMA1 — 优先级=可设；NVIC=NVIC->ISER[0].12；屏蔽位=DMA1_CFG->INTEN；子开关=DMA1_CFG->TCIE DMA1_CFG->HTIE DMA1_CFG->TEIE；标志位=DMA1_STS->GIF DMA1_STS->TCIF DMA1_STS->HTIF DMA1_STS->TEIF；唤醒 STOP=不能
13 DMA2 — 优先级=可设；NVIC=NVIC->ISER[0].13；屏蔽位=DMA2_CFG->INTEN；子开关=DMA2_CFG->TCIE DMA2_CFG->HTIE DMA2_CFG->TEIE；标志位=DMA2_STS->GIF DMA2_STS->TCIF DMA2_STS->HTIF DMA2_STS->TEIF；唤醒 STOP=不能
14 DMA3 — 优先级=可设；NVIC=NVIC->ISER[0].14；屏蔽位=DMA3_CFG->INTEN；子开关=DMA3_CFG->TCIE DMA3_CFG->HTIE DMA3_CFG->TEIE；标志位=DMA3_STS->GIF DMA3_STS->TCIF DMA3_STS->HTIF DMA3_STS->TEIF；唤醒 STOP=不能
15 TIM0 — 优先级=可设；NVIC=NVIC->ISER[0].15；屏蔽位=TIM0_IDE->INTEN；子开关=TIM0_IDE->TIE TIM0_IDE->EXFIE TIM0_IDE->EXRIE；标志位=TIM0_STS->TIF TIM0_STS->EXIF TIM0_STS->EXIR；唤醒 STOP=不能
16 TIM1 — 优先级=可设；NVIC=NVIC->ISER[0].16；屏蔽位=TIM1_IDE->INTEN；子开关=TIM1_IDE->TIE TIM1_IDE->EXFIE TIM1_IDE->EXRIE；标志位=TIM1_STS->TIF TIM1_STS->EXIF TIM1_STS->EXIR；唤醒 STOP=不能
17 TIM2 — 优先级=可设；NVIC=NVIC->ISER[0].17；屏蔽位=TIM2_IDE->INTEN；子开关=TIM2_IDE->TIE TIM2_IDE->EXFIE TIM2_IDE->EXRIE；标志位=TIM2_STS->TIF TIM2_STS->EXIF TIM2_STS->EXIR；唤醒 STOP=不能
18 TIM3 — 优先级=可设；NVIC=NVIC->ISER[0].18；屏蔽位=TIM3_IDE->INTEN；子开关=TIM3_IDE->TIE TIM3_IDE->EXFIE TIM3_IDE->EXRIE；标志位=TIM3_STS->TIF TIM3_STS->EXIF TIM3_STS->EXIR；唤醒 STOP=不能
19 TIM4_5 (TIM4, TIM5) — 共享中断源：TIM4 / TIM5；优先级=可设；NVIC=NVIC->ISER[0].19；屏蔽位=TIM4_IDE->INTEN；子开关=TIM4_IDE->TIE TIM4_IDE->EXFIE TIM4_IDE->EXRIE；标志位=TIM4_STS->TIF TIM4_STS->EXIF TIM4_STS->EXIR；唤醒 STOP=不能
20 TIM6_7 (TIM6, TIM7) — 共享中断源：TIM6 / TIM7；优先级=可设；NVIC=NVIC->ISER[0].20；屏蔽位=TIM6_IDE->INTEN；子开关=TIM6_IDE->TIE TIM6_IDE->EXFIE TIM6_IDE->EXRIE；标志位=TIM6_STS->TIF TIM6_STS->EXIF TIM6_STS->EXIR；唤醒 STOP=不能
21 PWM0 — 优先级=可设；NVIC=NVIC->ISER[0].21；屏蔽位=PWM0_CON->INTEN；标志位=PWM0_STS>PWMIF；唤醒 STOP=不能
22 LEDPWM — 优先级=可设；NVIC=NVIC->ISER[0].22；屏蔽位=LEDPWM_CON->INTEN；标志位=LEDPWM_STS>PWMIF；唤醒 STOP=不能
23 TWI0 — 优先级=可设；NVIC=NVIC->ISER[0].23；屏蔽位=TWI0_IDE->INTEN；标志位=TWI0_STS->TWIF；唤醒 STOP=不能
24 TWI1 — 优先级=可设；NVIC=NVIC->ISER[0].24；屏蔽位=TWI1_IDE->INTEN；标志位=TWI1_STS->TWIF；唤醒 STOP=不能
29 ADC — 优先级=可设；NVIC=NVIC->ISER[0].29；屏蔽位=ADC_CON->INTEN；标志位=ADC_STS->ADCIF；唤醒 STOP=不能
30 CMP — 优先级=可设；NVIC=NVIC->ISER[0].30；子开关=CMPCFG->CMPIM[1:0]；标志位=CMP_STS->CMPIF；唤醒 STOP=能
