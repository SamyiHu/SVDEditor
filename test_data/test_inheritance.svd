# TestDevice register map
File version: 1.0
Test device with inheritance
Registers are 32-bit, read-write, reset 0x0 unless marked. A register's access mark holds for its fields unless they carry their own. Offsets are from the block's base; lines under a group give offsets from that group; [hi:lo] are bit positions; {n}, {i} and the like mark numbered series; 'fields as' and 'values as' point back to an identical list; <NAME> marks a mode.

## Memory map
0x40000000 GPIOA — General Purpose I/O A
0x40000400 GPIOB — General Purpose I/O B

## GPIOA — General Purpose I/O A
Base 0x40000000
Same registers: GPIOB 0x40000400
0x00 MODER — Mode register
  [1:0] MODER0 — Port x configuration bits
